## Kconfig
```kconfig
#
# For a description of the syntax of this configuration file,
# see the file kconfig-language.txt in the NuttX tools repository.
#

config EXAMPLES_BTSTACK
	bool "btstack sample application"
	default n
	---help---
		Enable the btstack_demo

if EXAMPLES_BTSTACK

config EXAMPLES_BTSTACK_PROGNAME
	string "Program name"
	default "btapp"
	depends on BUILD_KERNEL
	---help---
		This is the name of the program that will be use when the NSH ELF
		program is installed.

config EXAMPLES_BTSTACK_PRIORITY
	int "Btstack_Demo task priority"
	default 100

config EXAMPLES_BTSTACK_STACKSIZE
	int "btstack stack size"
	default 2048

endif
```
